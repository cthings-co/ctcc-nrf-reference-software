## boards/ct/ctcc/Kconfig
```kconfig
# CTHINGS.CO Connectivity Card board configuration

# Copyright (c) 2024 CTHINGS.CO
# SPDX-License-Identifier: Apache-2.0

if BOARD_CTCC

if BOARD_CTCC_NRF52840

config BOARD_SERIAL_BACKEND_CDC_ACM
	bool "USB CDC"
	default y

endif # BOARD_CTCC_NRF52840

endif # BOARD_CTCC
```

## boards/ct/ctcc/Kconfig.defconfig
```kconfig
# CTHINGS.CO Connectivity Card board configuration

# Copyright (c) 2024 CTHINGS.CO
# SPDX-License-Identifier: Apache-2.0

if BOARD_CTCC_NRF52840

if BOARD_SERIAL_BACKEND_CDC_ACM

config USB_DEVICE_STACK
	default y

config USB_CDC_ACM
	default SERIAL

config CONSOLE
	default y

config UART_CONSOLE
	default CONSOLE

config USB_DEVICE_INITIALIZE_AT_BOOT
	default y if !MCUBOOT && CONSOLE

config USB_DEVICE_REMOTE_WAKEUP
	default n

if LOG

# Turn off logging for USB CDC ACM
choice USB_CDC_ACM_LOG_LEVEL_CHOICE
	default USB_CDC_ACM_LOG_LEVEL_OFF
endchoice

# Turn off logging for USB Device
choice USB_DEVICE_LOG_LEVEL_CHOICE
	default USB_DEVICE_LOG_LEVEL_OFF
endchoice

# Wait 5s at startup for logging
config LOG_PROCESS_THREAD_STARTUP_DELAY_MS
	default 5000

endif # LOG

if USB_DEVICE_STACK

config SERIAL
	default y

endif # USB_DEVICE_STACK

endif # BOARD_SERIAL_BACKEND_CDC_ACM

config BT_CTLR
	default BT

endif # BOARD_CTCC_NRF52840

if BOARD_CTCC_NRF9161 || BOARD_CTCC_NRF9161_NS || BOARD_CTCC_NRF9151 || BOARD_CTCC_NRF9151_NS

# For the secure version of the board the firmware is linked at the beginning
# of the flash, or into the code-partition defined in DT if it is intended to
# be loaded by MCUboot. If the secure firmware is to be combined with a non-
# secure image (TRUSTED_EXECUTION_SECURE=y), the secure FW image shall always
# be restricted to the size of its code partition.
# For the non-secure version of the board, the firmware
# must be linked into the code-partition (non-secure) defined in DT, regardless.
# Apply this configuration below by setting the Kconfig symbols used by
# the linker according to the information extracted from DT partitions.

# Workaround for not being able to have commas in macro arguments
DT_CHOSEN_Z_CODE_PARTITION := zephyr,code-partition

config FLASH_LOAD_SIZE
	default $(dt_chosen_reg_size_hex,$(DT_CHOSEN_Z_CODE_PARTITION))
	depends on BOARD_CTCC_NRF9161 && TRUSTED_EXECUTION_SECURE

if BOARD_CTCC_NRF9161_NS || BOARD_CTCC_NRF9151_NS

config FLASH_LOAD_OFFSET
	default $(dt_chosen_reg_addr_hex,$(DT_CHOSEN_Z_CODE_PARTITION))

config FLASH_LOAD_SIZE
	default $(dt_chosen_reg_size_hex,$(DT_CHOSEN_Z_CODE_PARTITION))

endif # BOARD_CTCC_NRF9161_NS || BOARD_CTCC_NRF9151_NS
endif # BOARD_CTCC_NRF9161 || BOARD_CTCC_NRF9161_NS || BOARD_CTCC_NRF9151 || BOARD_CTCC_NRF9151_NS
```

## boards/ct/ctcc/board.yml
```yaml
board:
  name: ctcc
  socs:
    - name: nrf52840
    - name: nrf9161
      variants:
        - name: 'ns'
    - name: nrf9151
      variants:
        - name: 'ns'
```

## boards/ct/ctcc/ctcc_nrf52840_defconfig
```kconfig
# SPDX-License-Identifier: Apache-2.0

# Enable MPU
CONFIG_ARM_MPU=y

# Enable hardware stack protection
CONFIG_HW_STACK_PROTECTION=y

# Enable GPIO
CONFIG_GPIO=y

# Board Kconfig.defconfig enables USB CDC ACM and should disable USB remote
# wakeup by default. It needs to be disabled here, because the USB nrfx
# driver always overwrites option from Kconfig mentioned above with the
# imply from CONFIG_USB_NRFX.
CONFIG_USB_DEVICE_REMOTE_WAKEUP=n

# USB VID
CONFIG_USB_DEVICE_VID=0x37A1
CONFIG_USB_DEVICE_MANUFACTURER="CTHINGS.CO"

# Boot banner
CONFIG_NCS_BOOT_BANNER=n
CONFIG_BOOT_BANNER=y
CONFIG_BOOT_BANNER_STRING=""

# Lock firmware by default
CONFIG_NRF_APPROTECT_LOCK=y
```

## boards/ct/ctcc/dts/bindings/ct,ctcc-wdisable.yaml
```yaml
# Copyright (c) 2024 CTHINGS.CO
# SPDX-License-Identifier: Apache-2.0

description: GPIO used as input for radio control

compatible: "ct,ctcc-wdisable"

include: base.yaml

properties:
  status:
    required: true

  gpios:
    type: phandle-array
    required: true
    description: |
      GPIO to use as input to control enable/disable radio
```
