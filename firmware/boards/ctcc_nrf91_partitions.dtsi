/*
 * Copyright (c) 2026 CTHINGS.CO
 *
 * SPDX-License-Identifier: Apache-2.0
 */

/*
 * Pin the nRF91 settings/NVS partition to the geometry earlier releases produced.
 *
 * This example no longer uses Partition Manager, so its flash map comes from
 * devicetree - and for nRF91 that is upstream's nrf91xx_partition.dtsi, which puts
 * storage_partition at 0xf8000 + 0x8000. The previous release pinned only `mcuboot`
 * in pm_static.yml and let Partition Manager place the rest, so a card flashed from
 * it has PM's default: size 0x2000 (partition-size=0x2000 in
 * nrf/subsys/partition_manager/Kconfig) placed `before: [tfm_storage, end]` with
 * `align: {start: NRF_TRUSTZONE_FLASH_REGION_SIZE}`, which on nRF91 is
 * NRF_SPU_FLASH_REGION_SIZE = 0x8000 - so 0xf8000 + 0x2000.
 *
 * The start address is the same either way, but the size decides how many sectors
 * NVS puts in its ring, and taking that from 2 to 8 silently re-orders the ring.
 * nvs_startup() scans for "an open sector following a closed sector" from sector 0
 * (zephyr/subsys/kvss/nvs/nvs.c:1026-1043). A 2-sector ring left with sector 1 closed
 * and sector 0 open - which is what a garbage collection leaves - then matches
 * closed@1 -> open@2, so the write pointer lands on sector 2 and reads walk backwards
 * through sector 1 before sector 0: a key last updated in sector 0 comes back as the
 * older copy from sector 1. No mount error, because closed_sectors never equals
 * sector_count. Keeping the deployed 0x2000 avoids the migration entirely.
 *
 * 0xfa000..0x100000 is left unclaimed, exactly as Partition Manager left it.
 */
&storage_partition {
	reg = <0x000f8000 0x00002000>;
};
