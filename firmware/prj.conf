## CMakeLists.txt
```
# Copyright (c) 2024 CTHINGS.CO
# SPDX-License-Identifier: Apache-2.0

cmake_minimum_required(VERSION 3.13.1)

find_package(Zephyr REQUIRED HINTS $ENV{ZEPHYR_BASE})

project(example)

set(src_dir ${CMAKE_CURRENT_SOURCE_DIR}/src)
set(inc_dir ${CMAKE_CURRENT_SOURCE_DIR}/inc)

target_sources(app PRIVATE
	${src_dir}/main.c)

include_directories(
	${inc_dir})
```

## sysbuild.conf
```
# Sysbuild configuration for the example application.
#
# MCUboot is the only thing this example asks for; the flash layout and the
# upgrade mode are left at the SDK default on purpose, so this stays a stock
# nRF Connect SDK build for the ctcc board:
#
#   * partitions come from the board devicetree - Partition Manager is deprecated
#     and off by default in this SDK,
#   * the upgrade mode is the NCS default, SB_CONFIG_MCUBOOT_MODE_SWAP_USING_MOVE,
#     which the board's equal-sized slots support.
#
# Product firmware may want to deviate - a single-slot loader, or a pinned flash
# map matching cards already in the field. That belongs in a product repository,
# not in an example.
SB_CONFIG_BOOTLOADER_MCUBOOT=y

# Keep the debug port open in EVERY image of this build, in one place.
#
# NCS offers this at sysbuild level (nrf/sysbuild/Kconfig.approtect): it sets
# CONFIG_NRF_APPROTECT_USE_UICR in the application, in MCUboot, and in any image a
# future sysbuild addition brings along - so a new child image cannot inherit the
# board's LOCK default just because nobody remembered to add a fragment for it. The
# symbol depends on SOC_SERIES_NRF52 || NRF53 || NRF91, so it is valid for all five
# ctcc targets.
#
# The per-image CONFIG_NRF_APPROTECT_USE_UICR lines in firmware/prj.conf and
# firmware/sysbuild/mcuboot/prj.conf are deliberately kept as well. They are not
# redundant: this file is read only by a sysbuild build, and both a
# `west build --no-sysbuild` of firmware/ and the assembly test (which is never a
# sysbuild build) rely on their own. For a "must not lock" invariant, having it stated
# where each image can see it is worth the repetition.
#
# nRF91's SECOND access port has its own sysbuild choice, SB_CONFIG_SECURE_APPROTECT_*,
# but it depends on SOC_SERIES_NRF91 and this file has no per-board variant - setting
# it here would log an unmet-dependency warning on every nRF52840 build. It therefore
# stays in firmware/boards/ctcc_nrf91*.conf and
# firmware/sysbuild/mcuboot/boards/ctcc_nrf91*.conf.
SB_CONFIG_APPROTECT_USE_UICR=y

# Do not push MCUBOOT_UPDATEABLE_IMAGES into the application image.
#
# nrf/sysbuild/CMakeLists.txt:281-285 syncs CONFIG_UPDATEABLE_IMAGE_NUMBER into every
# updateable image when SB_CONFIG_MCUBOOT_APP_SYNC_UPDATEABLE_IMAGES is set, and that
# option is `default y` (nrf/sysbuild/Kconfig.mcuboot:164-166). The example application
# has no image manager, so UPDATEABLE_IMAGE_NUMBER is an inactive symbol there and the
# assignment produced a Kconfig warning on every firmware and bootloader build:
#
#   warning: UPDATEABLE_IMAGE_NUMBER ... was assigned the value '1' but got the value ''.
#   Check these unsatisfied dependencies: ... (!MCUBOOT && IMG_MANAGER) (=n)
#
# The number still reaches MCUboot itself, which is the image that acts on it; only the
# redundant copy in the application is dropped. This costs nothing and does not require
# turning on IMG_MANAGER just to satisfy a value the application never reads.
SB_CONFIG_MCUBOOT_APP_SYNC_UPDATEABLE_IMAGES=n
```

## prj.conf
```kconfig
# Do NOT lock the debug port from the example. The ctcc board defaults the
# NRF_APPROTECT_HANDLING choice to NRF_APPROTECT_LOCK for every image
# (patches/zephyr/0003) - a choice DEFAULT, which is why a .conf can override it at
# all; a `select` could not be. Left alone it would make
# the app_protect helper write UICR.APPROTECT and reset on the first boot of this
# image on nRF52840 - so running the example once would lock the card, and the next
# flash over SWD would need `nrfjprog --recover` first. Selecting the SoC's default
# handling reverts that, and dropping the helper keeps it out of the image entirely
# (see drivers/misc/app_protect/Kconfig). The Open Bootloader built here does the
# same, so nothing in this repository locks a card - product firmware should, on the
# bootloader as well as the application.
#
# The CTCC_APP_PROTECT=n line below is load-bearing on THREE of the five targets, not
# on nRF52840 alone. The helper is restricted to BOARD_CTCC but has no further SoC
# dependency:
# drivers/misc/app_protect/Kconfig declares it `default y` with
# `depends on BOARD_CTCC && !ARM_NONSECURE_FIRMWARE`, so it is compiled into
# ctcc/nrf52840, ctcc/nrf9151 and ctcc/nrf9161 alike and is excluded only from the
# two /ns targets.
# On those three this line is the only thing stopping the first boot from writing
# UICR and resetting.
#
# NRF_APPROTECT_USE_UICR=y is load-bearing on every target, and on nRF91 it prevents a
# PERMANENT lock rather than merely a per-boot one. Which agent acts depends on the
# image: in a SECURE nRF91 image the MDK's SystemInit sets APPROTECT.FORCEPROTECT,
# which is volatile and gone after an erase; on a /ns target TF-M is the actor and its init_debug() ->
# configure_approtect_nvmc() writes the UICR word with nrfx_nvmc_word_write() -
# a flash write, PERMANENT, needing `nrfjprog --recover` afterwards. nRF91's
# SECOND, secure access port is opted out per board instead, in
# firmware/boards/ctcc_nrf91*.conf: the symbol is declared for every Nordic SoC but
# depends on SOC_NRF5340_CPUAPP || SOC_SERIES_NRF91, so assigning it on nRF52840 only
# logs "was assigned y but got n".
CONFIG_NRF_APPROTECT_USE_UICR=y
CONFIG_CTCC_APP_PROTECT=n

# Add your configs here
```

## boards/ctcc_nrf52840.conf
```kconfig
# USB descriptors for the example firmware. 0xF00F is the ctcc dummy PID (for
# tests/demos). Set here directly - a CI `-DCONFIG_CDC_ACM_SERIAL_PID` override
# does NOT reach the application image under sysbuild - so both CI and a plain
# local `west build` enumerate as the CTHINGS VID/PID instead of the Zephyr
# fallback 0x2FE3:0x0004.
CONFIG_CDC_ACM_SERIAL_VID=0x37A1
CONFIG_CDC_ACM_SERIAL_PID=0xF00F
CONFIG_CDC_ACM_SERIAL_MANUFACTURER_STRING="CTHINGS.CO"
CONFIG_CDC_ACM_SERIAL_PRODUCT_STRING="CTCC-DEVICE"

# Boot banner
CONFIG_NCS_BOOT_BANNER=n
CONFIG_BOOT_BANNER=y
# No BOOT_BANNER_STRING here: firmware/VERSION exists, so the banner patch takes its
# APP_VERSION_STRING branch and never reads the fallback string. tests/assembly has
# no VERSION file and does set it.

# APPROTECT (debug read-back lock) is defaulted board-wide by patches/zephyr/0003
# (the NRF_APPROTECT_HANDLING choice defaults to LOCK - a default, so a .conf can
# override it), so it is not set per-app here - but note that
# every image in this repository deliberately OPTS OUT again, and this example is
# one of them: see CONFIG_NRF_APPROTECT_USE_UICR=y and CONFIG_CTCC_APP_PROTECT=n in
# firmware/prj.conf, with the same pair in firmware/sysbuild/mcuboot/prj.conf and
# tests/assembly/prj.conf. Nothing built here locks a card; product firmware must,
# on the bootloader as well as the application.

# bMaxPower for the console CDC-ACM function, in 2 mA units: 50 = 100 mA, the same
# figure the Open Bootloader declares, so a card asks for the same budget whether it is
# running this image or sitting in serial recovery. The device-next default is 125
# (250 mA); nothing on this card needs it - the nRF52840 radio peaks around 20 mA and
# the module is powered from the mPCIe/M.2 slot, not from VBUS.
CONFIG_CDC_ACM_SERIAL_MAX_POWER=50
```

## boards/ctcc_nrf9161.conf
```kconfig
# Boot banner
CONFIG_NCS_BOOT_BANNER=n
CONFIG_BOOT_BANNER=y
# No BOOT_BANNER_STRING here: firmware/VERSION exists, so the banner patch takes its
# APP_VERSION_STRING branch and never reads the fallback string. tests/assembly has
# no VERSION file and does set it.

# APPROTECT (debug read-back lock) is defaulted board-wide by patches/zephyr/0003
# (the NRF_APPROTECT_HANDLING choice defaults to LOCK - a default, so a .conf can
# override it), so it is not set here - but nothing built in
# this repository actually locks: firmware/prj.conf opts every target back out with
# CONFIG_NRF_APPROTECT_USE_UICR=y (which selects the SoC's default handling, so the
# MDK's SystemInit does not force-protect this secure image; TF-M is not built for a
# non-/ns target) plus CONFIG_CTCC_APP_PROTECT=n. Product firmware must lock.

# nRF91 has a SECOND access port, and patches/zephyr/0003 now defaults its choice
# (NRF_SECURE_APPROTECT_HANDLING) to LOCK too, so SystemInit would force-protect it
# on every boot. Opt this target back out as well: nothing built in this repository
# locks a card, on either port. The symbol is declared for every Nordic SoC but carries
# `depends on SOC_NRF5340_CPUAPP || SOC_SERIES_NRF91`, so on nRF52840 its dependency
# is unmet and assigning it there logs "was assigned y but got n" - a warning, not an
# error. That is why it lives in a per-board conf rather than beside the other two
# opt-outs.
CONFIG_NRF_SECURE_APPROTECT_USE_UICR=y

# NOT BUILT BY CI. The matrix builds ctcc/nrf52840 and the two /ns targets; this
# secure-side variant exists for a product that wants the secure domain, and its
# fragments are therefore only exercised by hand. Verified manually against NCS
# v3.4.0: `west build --sysbuild -b ctcc/nrf9151 firmware/` configures, and the
# resolved .config carries NRF_APPROTECT_USE_UICR=y, NRF_SECURE_APPROTECT_USE_UICR=y
# and no CTCC_APP_PROTECT - i.e. both ports stay open, as intended. Re-check by hand
# after touching this file or patches/zephyr/0003.
#
# One thing main had and this branch does not: main's board Kconfig.defconfig clamped
# FLASH_LOAD_SIZE for the secure target. patches/zephyr/0002 selects
# USE_DT_CODE_PARTITION only for the /ns variants, so a secure image here links
# against the whole flash rather than a slot. That is correct for a standalone secure
# application and wrong for one behind MCUboot - so if a product builds this target
# WITH the bootloader, add the clamp back before trusting the image size.
```

## boards/ctcc_nrf9161_ns.conf
```kconfig
# Boot banner
CONFIG_NCS_BOOT_BANNER=n
CONFIG_BOOT_BANNER=y
# No BOOT_BANNER_STRING here: firmware/VERSION exists, so the banner patch takes its
# APP_VERSION_STRING branch and never reads the fallback string. tests/assembly has
# no VERSION file and does set it.

# nRF91 has a SECOND access port, and patches/zephyr/0003 now defaults its choice
# (NRF_SECURE_APPROTECT_HANDLING) to LOCK too. On a /ns target the actor is TF-M, not
# this image: its init_debug() -> configure_approtect_nvmc() writes
# UICR.SECUREAPPROTECT with nrfx_nvmc_word_write(), which is PERMANENT - not the
# volatile per-boot FORCEPROTECT a secure image's SystemInit applies. Opt this target back out as well: nothing built in this repository
# locks a card, on either port. The symbol is declared for every Nordic SoC but carries
# `depends on SOC_NRF5340_CPUAPP || SOC_SERIES_NRF91`, so on nRF52840 its dependency
# is unmet and assigning it there logs "was assigned y but got n" - a warning, not an
# error. That is why it lives in a per-board conf rather than beside the other two
# opt-outs.
CONFIG_NRF_SECURE_APPROTECT_USE_UICR=y
```

## ctcc_nrf52840_uicr.overlay
```dts
/*
 * Copyright (c) 2026 CTHINGS.CO
 * SPDX-License-Identifier: Apache-2.0
 *
 * ctcc/nrf52840 UICR configuration, applied by .ci_scripts/build_sdk.sh to every
 * image it builds for the card - the application AND the Open Bootloader.
 *
 * gpio-as-nreset routes the reset function to a GPIO so the card can be reset over
 * the mPCIe/M.2 PERST# line. This is not a hex record: the property makes the MDK's
 * SystemInit write UICR->PSELRESET and NVIC_SystemReset() once, on the first boot
 * of an image that carries it (system_nrf52.c, via NRF_CONFIG_GPIO_AS_PINRESET).
 * An image built without it never configures the pin.
 *
 * The upstream ctcc board leaves this to the application, so without this overlay
 * a card that has only ever run the standalone Open Bootloader - a stock card
 * waiting for its first image over serial recovery - has no PERST reset until an
 * application has booted once.
 *
 * The reference application also sets the property in its own board overlay
 * (firmware/boards/ctcc_nrf52840.overlay), which keeps a plain `west build` of
 * firmware/ correct on its own; setting the same boolean property twice is a no-op.
 *
 * Not applied to the assembly test: that image is flashed over SWD for
 * qualification and should not write UICR or reset the card under test.
 */

&uicr {
	gpio-as-nreset;
};
```

## boards/ctcc_nrf52840.overlay
```dts
/*
 * Copyright (c) 2025 CTHINGS.CO
 *
 * SPDX-License-Identifier: Apache-2.0
 */

/ {
};

/* Route the reset function to a GPIO so the card can be reset over the
 * mPCIe/M.2 PERST# line. The board this repository builds against comes from the
 * SDK (zephyr/boards/ct/ctcc) and does not set it - it is a UICR value, i.e. a
 * per-card decision, so the reference firmware opts in here. CI additionally
 * pushes firmware/ctcc_nrf52840_uicr.overlay into the loader image.
 */
&uicr {
	gpio-as-nreset;
};
```

## boards/ctcc_nrf9161_ns.overlay
```dts
/*
 * Copyright (c) 2026 CTHINGS.CO
 *
 * SPDX-License-Identifier: Apache-2.0
 */

/* Shared with the other three nRF91 targets - see the header there for why the
 * settings partition keeps the size earlier releases gave it. */
#include "ctcc_nrf91_partitions.dtsi"
```

## boards/ctcc_nrf91_partitions.dtsi
```dts
/*
 * Copyright (c) 2026 CTHINGS.CO
 *
 * SPDX-License-Identifier: Apache-2.0
 */

/*
 * Pin the nRF91 settings/NVS partition to the geometry earlier releases produced.
 *
 * This example no longer uses Partition Manager, so its flash map comes from
 * devicetree - and for nRF91 that is upstream's nrf91xx_partition.dtsi, which puts
 * storage_partition at 0xf8000 + 0x8000. The previous release pinned only `mcuboot`
 * in pm_static.yml and let Partition Manager place the rest, so a card flashed from
 * it has PM's default: size 0x2000 (partition-size=0x2000 in
 * nrf/subsys/partition_manager/Kconfig) placed `before: [tfm_storage, end]` with
 * `align: {start: NRF_TRUSTZONE_FLASH_REGION_SIZE}`, which on nRF91 is
 * NRF_SPU_FLASH_REGION_SIZE = 0x8000 - so 0xf8000 + 0x2000.
 *
 * The start address is the same either way, but the size decides how many sectors
 * NVS puts in its ring, and taking that from 2 to 8 silently re-orders the ring.
 * nvs_startup() scans for "an open sector following a closed sector" from sector 0
 * (zephyr/subsys/kvss/nvs/nvs.c:1026-1043). A 2-sector ring left with sector 1 closed
 * and sector 0 open - which is what a garbage collection leaves - then matches
 * closed@1 -> open@2, so the write pointer lands on sector 2 and reads walk backwards
 * through sector 1 before sector 0: a key last updated in sector 0 comes back as the
 * older copy from sector 1. No mount error, because closed_sectors never equals
 * sector_count. Keeping the deployed 0x2000 avoids the migration entirely.
 *
 * 0xfa000..0x100000 is left unclaimed, exactly as Partition Manager left it.
 */
&storage_partition {
	reg = <0x000f8000 0x00002000>;
};
```

## src/main.c
```c
/*
 * Copyright (c) 2024 CTHINGS.CO
 *
 * SPDX-License-Identifier: Apache-2.0
 */

#include <stdio.h>
#include <zephyr/kernel.h>

int main(void)
{
	while(1) {
		printf("Hello World! %s\n", CONFIG_BOARD_TARGET);
		k_sleep(K_SECONDS(1));
	}

	return 0;
}
```
