## CMakeLists.txt
```
# Copyright (c) 2025 CTHINGS.CO
# SPDX-License-Identifier: Apache-2.0

cmake_minimum_required(VERSION 3.13.1)

find_package(Zephyr REQUIRED HINTS $ENV{ZEPHYR_BASE})

project(assembly)

set(src_dir ${CMAKE_CURRENT_SOURCE_DIR}/src)
set(inc_dir ${CMAKE_CURRENT_SOURCE_DIR}/inc)

target_sources(app PRIVATE ${src_dir}/main.c)
target_sources_ifdef(CONFIG_SPI_NOR app PRIVATE ${src_dir}/spi_nor_tests.c)

include_directories(
	${inc_dir})
```

## prj.conf
```kconfig
# Do NOT lock the debug port from the assembly test. The ctcc board defaults the
# NRF_APPROTECT_HANDLING choice to NRF_APPROTECT_LOCK for every image
# (patches/zephyr/0003) - a choice default, which is what lets the two lines below
# override it at all. Left alone it would make the
# app_protect helper write UICR.APPROTECT and reset on the first boot of this
# (secure) image on nRF52840, and make TF-M write UICR.APPROTECT permanently on nRF91 -
# i.e. running the assembly test would lock the card it is meant to qualify, and
# the line would need `nrfjprog --recover` before flashing anything else.
# Selecting the SoC's default handling reverts both paths; dropping the helper as
# well keeps it out of the image entirely (see drivers/misc/app_protect/Kconfig).
# The example firmware and the Open Bootloader do the same, so all reference
# configurations leave debug access enabled.
# nRF91's SECOND access port is opted out per board instead, in
# boards/ctcc_nrf91*_ns.conf - CONFIG_NRF_SECURE_APPROTECT_USE_UICR does not exist
# on nRF52840, so it cannot live here.
CONFIG_NRF_APPROTECT_USE_UICR=y
CONFIG_CTCC_APP_PROTECT=n

# CTHINGS.CO boot banner. NCS_BOOT_BANNER=n is the load-bearing key: sdk-nrf ships
# `configdefault BOOT_BANNER / default n if NCS_BOOT_BANNER` and NCS_BOOT_BANNER
# defaults y, and that default is prepended ahead of Zephyr's own `default y`, so
# without this line BOOT_BANNER resolves n, the CTHINGS.CO printk from
# patches/zephyr/0001 is compiled out (it sits inside `#ifdef CONFIG_BOOT_BANNER`)
# and NCS prints its own banner instead. Setting NCS_BOOT_BANNER=n makes that
# condition false, so BOOT_BANNER falls through to Zephyr's `default y` and is y on
# its own - BOOT_BANNER=y below is therefore redundant today, kept explicit so the
# requirement stays visible if anything ever re-enables NCS_BOOT_BANNER.
# On main the deleted board's *_defconfig carried the pair, so every image built for
# the card inherited it; the board now comes from the SDK without it, which is why
# each image sets it for itself (firmware/boards/ctcc_*.conf do the same).
#
# BOOT_BANNER_STRING is NOT set here, and setting it would have no effect: the
# patch prints the firmware revision whenever <zephyr/app_version.h> exists and only
# falls back to `*** <BOOT_BANNER_STRING> <Zephyr version> <postfix> ***` when it does
# not. build_sdk.sh installs firmware/VERSION into this directory before building, so
# app_version.h is always generated and the revision branch is always the one taken -
# these images now announce the same revision as the firmware they qualify, instead of
# a bare Zephyr version.
CONFIG_NCS_BOOT_BANNER=n
CONFIG_BOOT_BANNER=y

# Ztest configs
CONFIG_ZTEST=y
CONFIG_TEST_USERSPACE=n
CONFIG_ZTEST_STACK_SIZE=4096

# Common configs
CONFIG_GPIO=y
CONFIG_SERIAL=y
CONFIG_CONSOLE=y
CONFIG_CONSOLE_SUBSYS=y
CONFIG_CONSOLE_GETCHAR=y
CONFIG_CONSOLE_GETCHAR_BUFSIZE=64
CONFIG_CONSOLE_PUTCHAR_BUFSIZE=512
```

## boards/ctcc_nrf52840.conf
```kconfig
# Copyright (c) 2026 CTHINGS.CO
# SPDX-License-Identifier: Apache-2.0

# The ctcc/nrf52840 assembly test runs its console over USB CDC ACM (the board's
# default serial backend, BOARD_SERIAL_BACKEND_CDC_ACM). Without these overrides
# the CDC ACM serial advertises the board's upstream-default (Zephyr) USB
# descriptors instead of the ctcc identity. 0xF00F is the ctcc dummy PID for
# tests and demos - the same one the example firmware uses, since both are
# development images; the product string keeps them apart in `lsusb`.
CONFIG_CDC_ACM_SERIAL_VID=0x37A1
CONFIG_CDC_ACM_SERIAL_PID=0xF00F
CONFIG_CDC_ACM_SERIAL_MANUFACTURER_STRING="CTHINGS.CO"
CONFIG_CDC_ACM_SERIAL_PRODUCT_STRING="CTCC-ASSEMBLY"

# bMaxPower for the console CDC-ACM function, in 2 mA units: 50 = 100 mA, the same
# figure the Open Bootloader declares, so a card asks for the same budget whether it is
# running this image or sitting in serial recovery. The device-next default is 125
# (250 mA); nothing on this card needs it - the nRF52840 radio peaks around 20 mA and
# the module is powered from the mPCIe/M.2 slot, not from VBUS.
CONFIG_CDC_ACM_SERIAL_MAX_POWER=50
```

## boards/ctcc_nrf9151_ns.conf
```kconfig
CONFIG_SPI=y
CONFIG_FLASH=y
CONFIG_SPI_NOR=y
```

## boards/ctcc_nrf9161_ns.conf
```kconfig
CONFIG_SPI=y
CONFIG_FLASH=y
CONFIG_SPI_NOR=y
# No board .overlay is needed for the external flash: patches/zephyr/0002 sets
# mx25r6435 status="okay" in ctcc_nrf91{51,61}_common.dtsi, so the node is already
# enabled for every image built for these targets.

# nRF91 console is uart0 (UARTE). The shared prj.conf enables CONSOLE_GETCHAR, whose
# tty layer is interrupt-driven and ring-buffered while either buffer is non-zero.
# Setting both to 0 makes it UNBUFFERED: with a zero-capacity ring buffer
# subsys/console/tty.c:104-112 falls through to a uart_poll_out() per byte, and the
# read side likewise. What that buys is the ~576 bytes of RAM the two buffers would
# occupy, plus a simpler path with no IRQ callback to install - not delivery. Buffered
# operation is not broken here, and printk is unaffected either way: it goes through
# the console backend, not this tty layer.
# Note UART_INTERRUPT_DRIVEN stays in the image regardless: CONSOLE_GETCHAR selects it
# (subsys/console/Kconfig), the buffer sizes do not. The nRF52840 target keeps the
# buffered path; its USB CDC ACM console drives it fine.
CONFIG_CONSOLE_PUTCHAR_BUFSIZE=0
CONFIG_CONSOLE_GETCHAR_BUFSIZE=0

# nRF91 has a SECOND access port, and patches/zephyr/0003 now defaults its choice
# (NRF_SECURE_APPROTECT_HANDLING) to LOCK too. On a /ns target the actor is TF-M, not
# this image: its init_debug() -> configure_approtect_nvmc() writes
# UICR.SECUREAPPROTECT with nrfx_nvmc_word_write(), which is PERMANENT - not the
# volatile per-boot FORCEPROTECT a secure image's SystemInit applies. Opt this target back out as well: nothing built in this repository
# locks a card, on either port. The symbol is declared for every Nordic SoC but carries
# `depends on SOC_NRF5340_CPUAPP || SOC_SERIES_NRF91`, so on nRF52840 its dependency
# is unmet and assigning it there logs "was assigned y but got n" - a warning, not an
# error. That is why it lives in a per-board conf rather than beside the other two
# opt-outs.
CONFIG_NRF_SECURE_APPROTECT_USE_UICR=y
```

## boards/ctcc_nrf9151_ns.overlay
```dts
/*
 * Copyright (c) 2026 CTHINGS.CO
 *
 * SPDX-License-Identifier: Apache-2.0
 *
 * Standalone build: relocate slot0 to flash origin.
 *
 * The board selects USE_DT_CODE_PARTITION for the /ns targets, so an image links
 * inside slot0 - correct when MCUboot loads it, wrong for this test, which has no
 * bootloader and must be startable by the boot ROM at 0x0. Move the whole group
 * rather than switching the mechanism off: `ranges` and the nested children keep
 * TF-M (slot0_s, +0) and the non-secure image (slot0_ns, +0x40000) consistent with
 * each other, which is what the secure/non-secure split needs.
 */

&slot0_partition {
	reg = <0x00000000 0x00070000>;
	ranges = <0x0 0x0 0x00070000>;
};
```

## src/main.c
```c
/*
 * Copyright (c) 2025 CTHINGS.CO
 *
 * SPDX-License-Identifier: Apache-2.0
 */

#include <zephyr/ztest.h>
#include <zephyr/kernel.h>
#include <zephyr/sys/printk.h>
#include <zephyr/console/console.h>
#include <zephyr/drivers/gpio.h>

/* LEDs */
#define LED0_NODE DT_ALIAS(led0)
static const struct gpio_dt_spec led0 = GPIO_DT_SPEC_GET(LED0_NODE, gpios);
#define LED1_NODE DT_ALIAS(led1)
static const struct gpio_dt_spec led1 = GPIO_DT_SPEC_GET(LED1_NODE, gpios);

ZTEST(assembly_base_tests, hello_console)
{
  for (int i = 0; i < 3; i++) {
		printk("Hello Console Test! %s\n\r", CONFIG_BOARD_TARGET);
  }
  printk("Waiting for any input to confirm it works both ways...\n\r");

  console_getchar();
}

ZTEST(assembly_base_tests, leds)
{
  /* Each CTCC has 2 LEDs signals, just turn them on and wait for confirmation */
  zassert_ok(!gpio_is_ready_dt(&led0));
  zassert_ok(!gpio_is_ready_dt(&led1));
	zassert_ok(gpio_pin_configure_dt(&led0, GPIO_OUTPUT_ACTIVE));
	zassert_ok(gpio_pin_configure_dt(&led1, GPIO_OUTPUT_ACTIVE));
	zassert_ok(gpio_pin_toggle_dt(&led0));
	zassert_ok(gpio_pin_toggle_dt(&led1));
  printk("Press 'y' to confirm LEDs are on...\n\r");

  uint8_t c = console_getchar();

  zassert_equal(c, 'y', "LEDs not confirmed to be working!");
	zassert_ok(gpio_pin_toggle_dt(&led0));
	zassert_ok(gpio_pin_toggle_dt(&led1));
}

static void *setup_assembly(void)
{
	console_init();

  return NULL;
}

ZTEST_SUITE(assembly_base_tests, NULL, setup_assembly, NULL, NULL, NULL);
```

## src/spi_nor_tests.c
```c
/*
 * Copyright (c) 2025 CTHINGS.CO
 *
 * SPDX-License-Identifier: Apache-2.0
 */

#include <zephyr/ztest.h>

#include <zephyr/drivers/flash.h>
#include <zephyr/drivers/gpio.h>
#include <zephyr/device.h>

#if DT_HAS_COMPAT_STATUS_OKAY(jedec_spi_nor)
#define SPI_FLASH_COMPAT jedec_spi_nor
#else
#error Unsupported flash driver
#endif
#define FLASH_TEST_REGION_OFFSET 0xff000
#define FLASH_SECTOR_SIZE        4096

ZTEST(spi_nor_tests, test_01_spi_nor_init)
{
	const struct device *flash_dev = DEVICE_DT_GET_ONE(SPI_FLASH_COMPAT);

	zassert_ok(!device_is_ready(flash_dev), "SPI flash driver was not found!\n");
}

ZTEST(spi_nor_tests, test_02_spi_nor_erase)
{
	const struct device *flash_dev = DEVICE_DT_GET_ONE(SPI_FLASH_COMPAT);
	int rc;

	zassert_ok(!device_is_ready(flash_dev), "SPI flash driver was not found!\n");

	rc = flash_erase(flash_dev, FLASH_TEST_REGION_OFFSET,
			 FLASH_SECTOR_SIZE);
	zassert_ok(rc, "Flash erase failed! %d\n", rc);
}

ZTEST(spi_nor_tests, test_03_spi_nor_write)
{
	const uint8_t expected[] = { 0x55, 0xaa, 0x66, 0x99 };
	const size_t len = sizeof(expected);
	const struct device *flash_dev = DEVICE_DT_GET_ONE(SPI_FLASH_COMPAT);
	int rc;

	zassert_ok(!device_is_ready(flash_dev), "SPI flash driver was not found!\n");

	rc = flash_write(flash_dev, FLASH_TEST_REGION_OFFSET, expected, len);
	zassert_ok(rc, "Flash write failed! %d\n", rc);
}

ZTEST(spi_nor_tests, test_04_spi_nor_verify)
{
	const uint8_t expected[] = { 0x55, 0xaa, 0x66, 0x99 };
	const size_t len = sizeof(expected);
	uint8_t buf[sizeof(expected)];
	const struct device *flash_dev = DEVICE_DT_GET_ONE(SPI_FLASH_COMPAT);
	int rc;

	zassert_ok(!device_is_ready(flash_dev), "SPI flash driver was not found!\n");

	memset(buf, 0, len);
	rc = flash_read(flash_dev, FLASH_TEST_REGION_OFFSET, buf, len);
	PRINT("I: expected: [0x%x][0x%x][0x%x][0x%x] | read: [0x%x][0x%x][0x%x][0x%x]",
			expected[0], expected[1], expected[2], expected[3],
			buf[0], buf[1], buf[2], buf[3]);
	zassert_ok(rc, "Flash read failed! %d\n", rc);

	zassert_ok(memcmp(expected, buf, len), "Data read does not match data written!!\n");
}

ZTEST(spi_nor_tests, test_05_spi_nor_clean_up)
{
	const uint8_t expected[] = { 0xff, 0xff, 0xff, 0xff };
	const size_t len = sizeof(expected);
	uint8_t buf[sizeof(expected)];
	const struct device *flash_dev = DEVICE_DT_GET_ONE(SPI_FLASH_COMPAT);
	int rc;

	zassert_ok(!device_is_ready(flash_dev), "SPI flash driver was not found!\n");

	rc = flash_erase(flash_dev, FLASH_TEST_REGION_OFFSET,
			 FLASH_SECTOR_SIZE);
	zassert_ok(rc, "Flash erase failed! %d\n", rc);

	memset(buf, 0, len);
	rc = flash_read(flash_dev, FLASH_TEST_REGION_OFFSET, buf, len);
	PRINT("I: expected: [0x%x][0x%x][0x%x][0x%x] | read: [0x%x][0x%x][0x%x][0x%x]",
			expected[0], expected[1], expected[2], expected[3],
			buf[0], buf[1], buf[2], buf[3]);
	zassert_ok(rc, "Flash read failed! %d\n", rc);

	zassert_ok(memcmp(expected, buf, len), "Data read does not match data written!!\n");
}

ZTEST_SUITE(spi_nor_tests, NULL, NULL, NULL, NULL, NULL);
```
